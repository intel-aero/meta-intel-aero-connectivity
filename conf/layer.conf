## conf/layer.conf
```bitbake
# We have a conf and classes directory, add to BBPATH
BBPATH .= ":${LAYERDIR}"

# We have recipes-* directories, add to BBFILES
BBFILES += "${LAYERDIR}/recipes-*/*/*.bb \
            ${LAYERDIR}/recipes-*/*/*.bbappend"

BBFILE_COLLECTIONS += "intel-aero-connectivity"
BBFILE_PATTERN_intel-aero-connectivity := "^${LAYERDIR}/"
BBFILE_PRIORITY_intel-aero-connectivity = "12"

# This should only be incremented on significant changes that will
# cause compatibility issues with other layers
LAYERVERSION_intel-aero-connectivity = "1"
```
